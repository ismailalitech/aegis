## CMakeLists.txt
```
# SPDX-License-Identifier: Apache-2.0
# Aegis non-secure network prover for the FRDM-RW612: ENET + lwIP (bare metal), a TCP server on port 7444 that hands
# every request line to the Aegis secure partition (psa_call) and sends its reply back. Built with sysbuild together
# with ../aegis_s; see ../README.md.
cmake_minimum_required(VERSION 3.22.0)

include(${SdkRootDirPath}/cmake/extension/mcux.cmake)
project(prover_ns LANGUAGES C CXX ASM)
include(${SdkRootDirPath}/CMakeLists.txt)
include(${SdkRootDirPath}/${board_root}/${board}/tfm_examples/tfm_demo/tfm_demo_ns/reconfig.cmake OPTIONAL)

mcux_add_source(BASE_PATH ${CMAKE_CURRENT_LIST_DIR} SOURCES src/main.c src/hardware_init.c)
# test builds only (probe.sh): AEGIS_NS_EXTRA_DEFINES="-DAEGIS_NS_PROBE_ADDR=0x... -DAEGIS_NS_PROBE_NAME=..."
if(DEFINED ENV{AEGIS_NS_EXTRA_DEFINES})
    mcux_add_macro(CC "$ENV{AEGIS_NS_EXTRA_DEFINES}")
endif()
mcux_add_include(BASE_PATH ${CMAKE_CURRENT_LIST_DIR} INCLUDES src ../aegis_pq)
mcux_add_macro(CC "-DFSL_FEATURE_PHYKSZ8081_USE_RMII50M_MODE -DLWIP_RAND=aegis_rand32 -DFSL_SDK_DISABLE_DRIVER_CLOCK_CONTROL=1")
mcux_add_armgcc_configuration(CC "-Wno-unused-variable -Wno-unused-but-set-variable -Wno-return-type -Wno-maybe-uninitialized")

set(NS_LD ${APPLICATION_BINARY_DIR}/tfm_common_ns_pre.ld)
execute_process(COMMAND $ENV{ARMGCC_DIR}/bin/arm-none-eabi-gcc -D${device}${core_id_suffix_name}_SERIES -E -P -xc
    -I${SdkRootDirPath}/middleware/tfm/tf-m/platform/ext/target/nxp/${board}/partition
    -I${SdkRootDirPath}/middleware/tfm/tf-m/platform/ext/common
    ${SdkRootDirPath}/middleware/tfm/tf-m/platform/ext/common/gcc/tfm_common_ns.ld -o ${NS_LD}
    RESULT_VARIABLE ld_rc)
if(NOT ld_rc EQUAL 0)
    message(FATAL_ERROR "preprocessing tfm_common_ns.ld failed")
endif()
mcux_remove_armgcc_linker_script(TARGETS debug release BASE_PATH ${SdkRootDirPath}
    LINKER ${device_root}/${soc_portfolio}/${soc_series}/${device}/gcc/${CONFIG_MCUX_TOOLCHAIN_LINKER_DEVICE_PREFIX}_flash.ld)
mcux_remove_armgcc_linker_script(TARGETS debug release BASE_PATH ${SdkRootDirPath}
    LINKER ${device_root}/${soc_portfolio}/${soc_series}/${device}/gcc/${CONFIG_MCUX_TOOLCHAIN_LINKER_DEVICE_PREFIX}_ram.ld)
mcux_add_armgcc_linker_script(BASE_PATH ${APPLICATION_BINARY_DIR} TARGETS debug release LINKER tfm_common_ns_pre.ld)

mcux_add_library(
    BASE_PATH ${APPLICATION_BINARY_DIR}
    LIBS "../aegis_s/${CONFIG_TOOLCHAIN}/aegis_s${core_id_suffix_name}_CMSE_lib.o"
    GENERATED TRUE
)
mcux_convert_binary(BINARY ${APPLICATION_BINARY_DIR}/${MCUX_SDK_PROJECT_NAME}.bin)
```

## Kconfig.sysbuild
```
# SPDX-License-Identifier: Apache-2.0
# The secure image is built with the same board, toolchain and configuration (NXP tfm_examples sysbuild options).
source "${SdkRootDirPath}/examples/tfm_examples/Kconfig.sysbuild"
```

## prj.conf
```kconfig
# SPDX-License-Identifier: Apache-2.0
# TF-M non-secure side, bare metal (no RTOS), same profile as the secure image
CONFIG_MCUX_COMPONENT_middleware.tfm.ns=y
CONFIG_MCUX_COMPONENT_middleware.tfm.profile_large=y
CONFIG_MCUX_COMPONENT_middleware.tfm.ns.os_wrapper.baremetal=y
CONFIG_MCUX_COMPONENT_device.startup=n
CONFIG_MCUX_COMPONENT_device.system=y
CONFIG_MCUX_PRJSEG_module.board.pinmux_board_folder=y
CONFIG_FLASH_BASE_ADDRESS=0x080A0000

# Ethernet: ENET, the board's KSZ8081 PHY, NXP's lwIP port (as in lwip_examples/lwip_dhcp/bm for this board)
CONFIG_MCUX_COMPONENT_driver.enet=y
CONFIG_MCUX_COMPONENT_component.phyksz8081=y
CONFIG_MCUX_COMPONENT_component.lpc_gpio_adapter=y
CONFIG_MCUX_COMPONENT_utility.assert=y
CONFIG_MCUX_COMPONENT_middleware.lwip=y
CONFIG_MCUX_COMPONENT_middleware.lwip.kinetis_ethernetif=y
CONFIG_MCUX_PRJSEG_middleware.lwip.generated_config=y

# lwIP: no OS, IPv4, DHCP, TCP; random numbers from TF-M's PSA RNG (hardware TRNG), not the port's fixed-seed LCG
CONFIG_LWIP_OPT_H_CODE_LINE_1="void sys_check_core_locking(void);"
CONFIG_LWIP_OPT_H_CODE_LINE_2="unsigned int aegis_rand32(void);"
CONFIG_NO_SYS=y
CONFIG_LWIP_NETCONN=n
CONFIG_LWIP_SOCKET=n
CONFIG_LWIP_ASSERT_CORE_LOCKED( )="sys_check_core_locking()"
CONFIG_MEM_ALIGNMENT=4
CONFIG_MEM_SIZE=32768
CONFIG_MEMP_NUM_PBUF=16
CONFIG_MEMP_NUM_UDP_PCB=4
CONFIG_MEMP_NUM_TCP_PCB=8
CONFIG_MEMP_NUM_TCP_PCB_LISTEN=2
CONFIG_MEMP_NUM_TCP_SEG=32
CONFIG_MEMP_NUM_SYS_TIMEOUT="10"
CONFIG_MEMP_NUM_REASSDATA=2
CONFIG_PBUF_POOL_SIZE=8
CONFIG_LWIP_TCP=y
CONFIG_TCP_TTL=255
CONFIG_TCP_QUEUE_OOSEQ=n
CONFIG_TCP_MSS=1460
CONFIG_TCP_SND_BUF="(8 * TCP_MSS)"
CONFIG_TCP_SND_QUEUELEN="((3 * TCP_SND_BUF) / TCP_MSS)"
CONFIG_TCP_WND="(4 * TCP_MSS)"
CONFIG_TCP_LISTEN_BACKLOG=y
CONFIG_LWIP_ICMP=y
CONFIG_LWIP_DHCP=y
CONFIG_LWIP_UDP=y
CONFIG_UDP_TTL=255
CONFIG_LWIP_STATS=n
CONFIG_LWIP_PROVIDE_ERRNO=y
CONFIG_LWIP_NETIF_EXT_STATUS_CALLBACK=y
CONFIG_IP_REASS_MAX_PBUFS=4
CONFIG_LWIP_SINGLE_NETIF=y

# our own hardware_init.c and app.h (src/), not the board port folder
CONFIG_MCUX_HAS_PRJSEG_project.use_hw_app=n

# the non-secure client of NXP loader service: not used (the secure partition is left out of aegis_s)
CONFIG_MCUX_COMPONENT_middleware.tfm.ns.loader_service=n
```

## src/main.c
```c
/* SPDX-License-Identifier: Apache-2.0
 *
 * Aegis non-secure network prover for the FRDM-RW612 (TF-M). It holds no key and computes no proof: every request
 * line that arrives on TCP port 7444 goes to the Aegis secure partition with psa_call, and the reply goes back,
 * one request per connection, as with the other Aegis endpoints. The MAC address is 02:ae plus the first four bytes
 * of the partition's ML-DSA-65 public key.
 */
#include <stdio.h>
#include <string.h>

#include "app.h"
#include "board.h"
#include "ethernetif.h"
#include "fsl_debug_console.h"
#include "fsl_phy.h"
#include "lwip/dhcp.h"
#include "lwip/init.h"
#include "lwip/netif.h"
#include "lwip/tcp.h"
#include "lwip/timeouts.h"
#include "netif/ethernet.h"
#include "psa/client.h"
#include "psa/crypto.h"
#include "aegis_pq_defs.h"

#define PORT        7444
#define AEGIS_NS_LINE_MAX    14600u /* AEGIS_LINE_MAX: PQKEMFIN with a 6 KB credential, in hex */
#define AEGIS_NS_REPLY_MAX   9600u  /* AEGIS_REPLY_MAX */
#define IDLE_POLLS  20     /* x 500 ms: a client that sends nothing for 10 s is dropped */

static char line[AEGIS_NS_LINE_MAX + 1];
static char reply[AEGIS_NS_REPLY_MAX + 2];
static size_t line_len, reply_len, reply_sent;
static struct tcp_pcb *client;
static int idle;
static uint32_t served;

unsigned int aegis_rand32(void)
{
	uint32_t r = 0;

	(void)psa_generate_random((uint8_t *)&r, sizeof(r));
	return r;
}

/* Replaces the device's weak SystemInit for the non-secure image. TF-M has already set clocks, the flash cache and
 * the FPU access rights; the device version would also read the flash-cache registers, which the Aegis target_cfg.c
 * makes secure-only (a non-secure access there is a SecureFault). Only the FPU access needs setting here. */
void SystemInit(void)
{
#if ((__FPU_PRESENT == 1) && (__FPU_USED == 1))
	SCB->CPACR |= ((3UL << 10 * 2) | (3UL << 11 * 2));
#endif
}

void SysTick_Handler(void)
{
	time_isr();
}

/* one line to the secure partition; the reply (without line end) into reply[] */
static void secure_request(const char *l, size_t n)
{
	psa_invec in = {l, n};
	psa_outvec out = {reply, AEGIS_NS_REPLY_MAX};
	psa_status_t st = psa_call(AEGIS_PQ_SERVICE_HANDLE, AEGIS_PQ_LINE, &in, 1, &out, 1);

	if (st == PSA_SUCCESS) {
		reply_len = out.len;
	} else {
		reply_len = (size_t)snprintf(reply, AEGIS_NS_REPLY_MAX, "ERR secure %d", (int)st);
	}
}

static void finish(struct tcp_pcb *pcb, int abort)
{
	tcp_arg(pcb, NULL);
	tcp_recv(pcb, NULL);
	tcp_sent(pcb, NULL);
	tcp_err(pcb, NULL);
	tcp_poll(pcb, NULL, 0);
	if (abort || tcp_close(pcb) != ERR_OK) {
		tcp_abort(pcb);
	}
	client = NULL;
}

static void send_more(struct tcp_pcb *pcb)
{
	while (reply_sent < reply_len) {
		size_t room = tcp_sndbuf(pcb), n = reply_len - reply_sent;

		if (room == 0) {
			break;
		}
		if (n > room) {
			n = room;
		}
		if (tcp_write(pcb, reply + reply_sent, (u16_t)n, TCP_WRITE_FLAG_COPY) != ERR_OK) {
			break;
		}
		reply_sent += n;
	}
	tcp_output(pcb);
}

static err_t on_sent(void *arg, struct tcp_pcb *pcb, u16_t len)
{
	(void)arg;
	(void)len;
	idle = 0;
	if (reply_sent < reply_len) {
		send_more(pcb);
	} else if (tcp_sndqueuelen(pcb) == 0) {
		finish(pcb, 0);
	}
	return ERR_OK;
}

static err_t on_recv(void *arg, struct tcp_pcb *pcb, struct pbuf *p, err_t err)
{
	char *nl;

	(void)arg;
	if (p == NULL || err != ERR_OK) {
		if (p) {
			pbuf_free(p);
		}
		finish(pcb, 0);
		return ERR_OK;
	}
	idle = 0;
	if (reply_len) { /* one request per connection: ignore anything after it */
		tcp_recved(pcb, p->tot_len);
		pbuf_free(p);
		return ERR_OK;
	}
	if (line_len + p->tot_len <= AEGIS_NS_LINE_MAX) {
		pbuf_copy_partial(p, line + line_len, p->tot_len, 0);
		line_len += p->tot_len;
	} else {
		line_len = AEGIS_NS_LINE_MAX + 1; /* too long: answered below */
	}
	tcp_recved(pcb, p->tot_len);
	pbuf_free(p);
	if (line_len > AEGIS_NS_LINE_MAX) {
		reply_len = (size_t)snprintf(reply, AEGIS_NS_REPLY_MAX, "ERR too-long");
	} else {
		line[line_len] = '\0';
		nl = memchr(line, '\n', line_len);
		if (nl == NULL) {
			return ERR_OK; /* wait for the rest of the line */
		}
		*nl = '\0';
		if (nl > line && nl[-1] == '\r') {
			nl[-1] = '\0';
		}
		secure_request(line, strlen(line));
		served++;
	}
	reply[reply_len++] = '\r';
	reply[reply_len++] = '\n';
	reply_sent = 0;
	send_more(pcb);
	return ERR_OK;
}

static void on_err(void *arg, err_t err)
{
	(void)arg;
	(void)err;
	client = NULL; /* the pcb is already freed by lwIP */
}

static err_t on_poll(void *arg, struct tcp_pcb *pcb)
{
	(void)arg;
	if (++idle >= IDLE_POLLS) {
		finish(pcb, 1);
		return ERR_ABRT;
	}
	return ERR_OK;
}

static err_t on_accept(void *arg, struct tcp_pcb *pcb, err_t err)
{
	(void)arg;
	if (err != ERR_OK || pcb == NULL) {
		return ERR_VAL;
	}
	if (client != NULL) { /* one request at a time: a second client is refused */
		tcp_abort(pcb);
		return ERR_ABRT;
	}
	client = pcb;
	line_len = reply_len = reply_sent = 0;
	idle = 0;
	tcp_recv(pcb, on_recv);
	tcp_sent(pcb, on_sent);
	tcp_err(pcb, on_err);
	tcp_poll(pcb, on_poll, 1);
	return ERR_OK;
}

static int hexval(char c)
{
	return c >= '0' && c <= '9' ? c - '0' : c >= 'a' && c <= 'f' ? c - 'a' + 10 : -1;
}

/* MAC = 02:ae + the first 4 bytes of the ML-DSA public key, from the partition's PQKEY reply "PQKEY 1952 <hex> END" */
static int mac_from_key(uint8_t mac[6])
{
	const char *h;

	secure_request("PQKEY", 5);
	reply[reply_len < AEGIS_NS_REPLY_MAX ? reply_len : AEGIS_NS_REPLY_MAX - 1] = '\0';
	if (strncmp(reply, "PQKEY 1952 ", 11) != 0) {
		return -1;
	}
	h = reply + 11;
	mac[0] = 0x02;
	mac[1] = 0xae;
	for (int i = 0; i < 4; i++) {
		int a = hexval(h[2 * i]), b = hexval(h[2 * i + 1]);

		if (a < 0 || b < 0) {
			return -1;
		}
		mac[2 + i] = (uint8_t)(a << 4 | b);
	}
	return 0;
}

int main(void)
{
	static phy_handle_t phy;
	static struct netif netif;
	ethernetif_config_t cfg = {.phyHandle = &phy, .phyAddr = EXAMPLE_PHY_ADDRESS, .phyOps = EXAMPLE_PHY_OPS,
				   .phyResource = EXAMPLE_PHY_RESOURCE};
	struct tcp_pcb *listener;
	int bound = 0;

	BOARD_InitHardware();
	time_init();
#if defined(AEGIS_NS_PROBE_ADDR)
	/* TEST BUILD ONLY (tools: endpoints/rw612/tfm/probe.sh): read one peripheral register from the non-secure side.
	 * For a peripheral the Aegis target_cfg.c makes secure-only, the read must fault and never print "read ok". */
	PRINTF("aegis-probe: non-secure read of %s at 0x%08x ...\r\n", AEGIS_NS_PROBE_NAME, (unsigned)AEGIS_NS_PROBE_ADDR);
	{
		volatile uint32_t v = *(volatile uint32_t *)(uintptr_t)AEGIS_NS_PROBE_ADDR;

		PRINTF("aegis-probe: read ok, value 0x%08x\r\n", (unsigned)v);
	}
#endif
	PRINTF("AEGIS-RW612-TFM-PROVER %s (non-secure network side; the key and the proofs are in the secure partition)\r\n",
	       "0.2.0");
	if (mac_from_key(cfg.macAddress) != 0) {
		static const uint8_t fallback[6] = {0x02, 0xae, 0x00, 0x00, 0x00, 0x01};

		memcpy(cfg.macAddress, fallback, 6);
		PRINTF("aegis: no key from the secure partition (%.40s); fixed MAC\r\n", reply);
	}
	{
		/* the lite debug console ignores the 0 flag of %02x, so format the address by hand */
		static const char hx[] = "0123456789abcdef";
		char m[18];

		for (int i = 0; i < 6; i++) {
			m[3 * i] = hx[cfg.macAddress[i] >> 4];
			m[3 * i + 1] = hx[cfg.macAddress[i] & 15];
			m[3 * i + 2] = i < 5 ? ':' : '\0';
		}
		PRINTF("aegis: mac %s\r\n", m);
	}
	cfg.srcClockHz = EXAMPLE_CLOCK_FREQ;
	lwip_init();
	netif_add(&netif, NULL, NULL, NULL, &cfg, ethernetif0_init, ethernet_input);
	netif_set_default(&netif);
	netif_set_up(&netif);
	while (ethernetif_wait_linkup(&netif, 5000) != ERR_OK) {
		PRINTF("aegis: no Ethernet link yet\r\n");
	}
	dhcp_start(&netif);
	listener = tcp_new();
	tcp_bind(listener, IP_ADDR_ANY, PORT);
	listener = tcp_listen(listener);
	tcp_accept(listener, on_accept);
	for (;;) {
		ethernetif_input(&netif);
		sys_check_timeouts();
		if (!bound && dhcp_supplied_address(&netif)) {
			bound = 1;
			PRINTF("aegis: address %s, listening on %d\r\n", ipaddr_ntoa(&netif.ip_addr), PORT);
		}
	}
}
```

## src/app.h
```c
/* SPDX-License-Identifier: Apache-2.0 */
#ifndef APP_H
#define APP_H
#include "fsl_phyksz8081.h"

extern phy_ksz8081_resource_t g_phy_resource;
#define EXAMPLE_ENET         ENET
#define EXAMPLE_PHY_ADDRESS  0x02U
#define EXAMPLE_PHY_OPS      &phyksz8081_ops
#define EXAMPLE_PHY_RESOURCE &g_phy_resource
#define EXAMPLE_CLOCK_FREQ   SystemCoreClock /* main clock 260 MHz, set by the secure side; CLKCTL0 is secure-only */
#define AEGIS_DEBUG_UART_CLK_HZ 20000000U /* FLEXCOMM3 via FRG3 from frg_pll, as the secure side sets it */

void BOARD_InitHardware(void);
#endif
```

## src/hardware_init.c
```c
/* SPDX-License-Identifier: Apache-2.0
 * Non-secure board set-up for the Aegis network prover. TF-M's secure image has already set the clocks (PLLs, FlexSPI,
 * the debug UART); calling BOARD_InitBootClocks here would touch ELS, which is secure-only, and reprogram clocks the
 * code is running from. The Aegis target_cfg.c also makes RSTCTL0, CLKCTL0 and SYSCTL0 secure-only, so nothing here may
 * touch them: the clock frequencies are constants (SystemCoreClock 260 MHz, the console's 20 MHz), and the secure
 * partition switches the Ethernet controller's clocks on before this image runs. */
#include "app.h"
#include "board.h"
#include "fsl_enet.h"
#include "fsl_gpio.h"
#include "fsl_reset.h"
#include "pin_mux.h"
#include "fsl_debug_console.h"

phy_ksz8081_resource_t g_phy_resource;

static status_t mdio_write(uint8_t phy, uint8_t reg, uint16_t data)
{
	return ENET_MDIOWrite(EXAMPLE_ENET, phy, reg, data);
}

static status_t mdio_read(uint8_t phy, uint8_t reg, uint16_t *data)
{
	return ENET_MDIORead(EXAMPLE_ENET, phy, reg, data);
}

void BOARD_InitHardware(void)
{
	gpio_pin_config_t out = {kGPIO_DigitalOutput, 1U}, in = {kGPIO_DigitalInput, 0U};

	/* the pins are muxed by the secure partition (the pin mux is secure-only) */
	/* the secure side set up FLEXCOMM3 and its FRG (20 MHz, measured on this board): only the driver state here */
	DbgConsole_Init(3U, 115200U, kSerialPort_Uart, AEGIS_DEBUG_UART_CLK_HZ);
	/* the ENET clocks and reset are done by the secure partition (RSTCTL0/CLKCTL0 are secure-only); GPIO is in
	 * CLKCTL1/RSTCTL1, still non-secure, and the drivers are built without clock control */
	CLOCK_EnableClock(kCLOCK_HsGpio0);
	CLOCK_EnableClock(kCLOCK_HsGpio1);
	GPIO_PortInit(GPIO, 0U);
	GPIO_PortInit(GPIO, 1U);
	GPIO_PinInit(GPIO, 0U, 21U, &out); /* PHY reset */
	GPIO_PinInit(GPIO, 1U, 23U, &in);  /* PHY interrupt (unused) */
	GPIO_PinWrite(GPIO, 0U, 21U, 0U);
	SDK_DelayAtLeastUs(100000, SystemCoreClock);
	GPIO_PinWrite(GPIO, 0U, 21U, 1U);
	ENET_SetSMI(EXAMPLE_ENET, EXAMPLE_CLOCK_FREQ, false);
	g_phy_resource.read = mdio_read;
	g_phy_resource.write = mdio_write;
}
```
