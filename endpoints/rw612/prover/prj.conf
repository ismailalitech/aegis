## CMakeLists.txt
```
# SPDX-License-Identifier: Apache-2.0
# Aegis prover for the NXP FRDM-RW612 (Zephyr application). Build: endpoints/rw612/build.sh
cmake_minimum_required(VERSION 3.20.0)
find_package(Zephyr REQUIRED HINTS $ENV{ZEPHYR_BASE})
project(aegis_rw612_prover)

set(MLDSA_NATIVE_DIR "$ENV{HOME}/aegis-tools/mldsa-native/mldsa" CACHE PATH "mldsa-native v2.0.0 mldsa/ directory")
set(MLKEM_NATIVE_DIR "$ENV{HOME}/aegis-tools/mlkem-native/mlkem" CACHE PATH "mlkem-native v2.0.0 mlkem/ directory")
# the Prover SDK: the protocol core, KMAC256, SHA-256 and the PQ library configurations (src/main.c is its port)
set(SDK ${CMAKE_CURRENT_LIST_DIR}/../../../sdk)
# the pinned gateway key (gateway_pk.h, written by tools/gen_gateway_pin.py)
set(PART ${CMAKE_CURRENT_LIST_DIR}/../../stm32h573/tfm-aegis-partition)
# only the ELS driver layer of NXP's els_pkc (key management, CKDF, HMAC), not the whole library
set(ELS_PKC ${ZEPHYR_HAL_NXP_MODULE_DIR}/nxp_crypto_hal/els_pkc/src)
set(ELS ${ELS_PKC}/comps/mcuxClEls/src)

target_sources(app PRIVATE
    src/main.c
    src/aegis_els.c
    ${SDK}/src/aegis_proto.c
    ${SDK}/src/aegis_sha256.c
    ${SDK}/src/aegis_kmac.c
    ${SDK}/crypto/mlkem_unit.c
    ${MLDSA_NATIVE_DIR}/mldsa_native.c
    ${ELS}/mcuxClEls_Common.c
    ${ELS}/mcuxClEls_GlitchDetector.c
    ${ELS}/mcuxClEls_KeyManagement.c
    ${ELS}/mcuxClEls_Kdf.c
    ${ELS}/mcuxClEls_Hmac.c
)
target_include_directories(app PRIVATE
    src
    ${SDK}/include
    ${SDK}/src
    ${PART}
    ${SDK}/crypto/mldsa
    ${MLDSA_NATIVE_DIR}
    ${SDK}/crypto/mlkem
    ${MLKEM_NATIVE_DIR}
    ${ELS_PKC}/platforms/rw61x
    ${ELS_PKC}/platforms/rw61x/inc
    ${ELS_PKC}/comps/mcuxCsslCPreProcessor/inc
    ${ELS_PKC}/comps/mcuxCsslFlowProtection/inc
    ${ELS_PKC}/comps/mcuxCsslSecureCounter/inc
    ${ELS_PKC}/comps/mcuxCsslDataIntegrity/inc
    ${ELS_PKC}/comps/mcuxCsslParamIntegrity/inc
    ${ELS_PKC}/comps/mcuxCsslMemory/inc
    ${ELS_PKC}/comps/mcuxClCore/inc
    ${ELS_PKC}/comps/mcuxClMemory/inc
    ${ELS_PKC}/comps/mcuxClEls/inc
    ${ELS_PKC}/comps/mcuxClEls/inc/internal
)
target_compile_definitions(app PRIVATE MLD_CONFIG_FILE="aegis_mldsa_config.h")
```

## prj.conf
```kconfig
# SPDX-License-Identifier: Apache-2.0
# Aegis prover for the FRDM-RW612
CONFIG_ENTROPY_GENERATOR=y

CONFIG_NETWORKING=y
CONFIG_NET_IPV4=y
CONFIG_NET_IPV6=n
CONFIG_NET_TCP=y
CONFIG_NET_DHCPV4=y
CONFIG_NET_SOCKETS=y
CONFIG_NET_MGMT=y
CONFIG_NET_MGMT_EVENT=y
CONFIG_NET_L2_ETHERNET_MGMT=y
CONFIG_NET_PKT_RX_COUNT=48
CONFIG_NET_PKT_TX_COUNT=48
CONFIG_NET_BUF_RX_COUNT=96
CONFIG_NET_BUF_TX_COUNT=96
CONFIG_NET_MAX_CONTEXTS=24
# every closed connection keeps its context through TCP TIME_WAIT; the gateway opens several in a row
CONFIG_NET_MAX_CONN=24
CONFIG_NET_TCP_MAX_RECV_WINDOW_SIZE=16384
CONFIG_NET_HOSTNAME_ENABLE=y
CONFIG_NET_HOSTNAME="aegis-rw612"

CONFIG_LOG=y
CONFIG_NET_LOG=y
CONFIG_PRINTK=y
```

## src/main.c
```c
/* SPDX-License-Identifier: Apache-2.0
 *
 * Aegis prover for the NXP FRDM-RW612 (RW612: Cortex-M33 at 260 MHz, ELS, Ethernet with a KSZ8081 PHY), Zephyr.
 *
 * At start:
 *   seed      = ELS: HMAC-SHA256(CKDF(die master key), "aegis-rw612-mldsa65-seed-v1")   (aegis_els.c)
 *   prov_root = ELS: HMAC-SHA256(CKDF(die master key), "aegis-rw612-provision-root-v1")
 *   (pk, sk)  = ML-DSA-65.KeyGen_internal(seed); the seed is wiped
 * Then DHCP on the Ethernet port, and the Aegis line protocol on TCP 7444, one request per connection. The protocol
 * is the Prover SDK's core (sdk/src/aegis_proto.c); this file is the SDK's port to the single-image firmware (struct
 * aegis_platform, sdk/include/aegis_sdk.h) and the transport. The quote reports one measurement, APP: SHA-256 of this
 * firmware image as it sits in flash, hashed again at every quote.
 * The MAC address is 02:ae + the first 4 bytes of the ML-DSA public key, as on the STM32 endpoints.
 */
#include <stdio.h>
#include <string.h>
#include <zephyr/drivers/entropy.h>
#include <zephyr/kernel.h>
#include <zephyr/net/ethernet.h>
#include <zephyr/net/ethernet_mgmt.h>
#include <zephyr/net/net_if.h>
#include <zephyr/net/net_mgmt.h>
#include <zephyr/net/dhcpv4.h>
#include <zephyr/net/socket.h>
#include <zephyr/sys/printk.h>

#include "aegis_els.h"
#include "aegis_sdk.h"
#include "gateway_pk.h"
#include "aegis_sha256.h"

#define PORT 7444

extern char __rom_region_start[];
extern char _flash_used[];

static const struct device *const trng = DEVICE_DT_GET(DT_CHOSEN(zephyr_entropy));
/* what the claims and the status text call this firmware (a build may set them with -D) */
#ifndef AEGIS_DEVICE_PROFILE
#define AEGIS_DEVICE_PROFILE "aegis-rw612-els-v1"
#endif
#ifndef AEGIS_DEVICE_FW
#define AEGIS_DEVICE_FW      "rw612"
#endif
#ifndef AEGIS_DEVICE_VERSION
#define AEGIS_DEVICE_VERSION "0.1.0"
#endif
#define CLAIMS_MAX 1024u /* the claims with one component take about 280 bytes */

static const uint8_t gateway_pk[AEGIS_PK_LEN] = AEGIS_GATEWAY_PK;
static struct aegis_prover core; /* the SDK core's context: the keys and the session live here */
static uint8_t work[AEGIS_WORK_LEN(CLAIMS_MAX)];
static struct aegis_measurement components[1];
static char line[AEGIS_LINE_MAX + 2];
static char reply[AEGIS_REPLY_MAX];

static int dev_random(void *user, uint8_t *out, size_t n)
{
	ARG_UNUSED(user);
	return entropy_get_entropy(trng, out, (uint16_t)n);
}

static void dev_measure(uint8_t out[32], size_t *len)
{
	*len = (size_t)_flash_used;
	aegis_sha256((const uint8_t *)__rom_region_start, *len, out);
}

/* One measured component, APP: the image as it is in flash now. */
static int dev_measurements(void *user, const struct aegis_measurement **list, size_t *count)
{
	size_t len;

	ARG_UNUSED(user);
	dev_measure(components[0].value, &len);
	components[0].label = "APP";
	snprintf(components[0].desc, sizeof(components[0].desc), "SHA256 of the firmware image (%u bytes)", (unsigned)len);
	*list = components;
	*count = 1;
	return 0;
}

static int dev_status(void *user, char *buf, size_t cap)
{
	ARG_UNUSED(user);
	return snprintf(buf, cap, "uptime_s=%u;link=1;fw=%s-%s", (unsigned)(uint32_t)(k_uptime_get() / 1000),
			AEGIS_DEVICE_FW, AEGIS_DEVICE_VERSION);
}

/* The session clock: Zephyr's uptime, 64 bits of milliseconds counted by the kernel from the RW612's OS timer. This
 * prover is one image with no secure side, so the clock is as trusted as the rest of the firmware ("device-key"). */
static int dev_monotonic(void *user, uint64_t *now)
{
	int64_t ms = k_uptime_get();

	ARG_UNUSED(user);
	if (ms < 0) {
		return -1;
	}
	*now = (uint64_t)ms / 1000u;
	return 0;
}

static const struct aegis_platform platform = {
	.random = dev_random,
	.clock = dev_monotonic,
	.clock_hz = 1, /* dev_monotonic gives seconds */
	.measurements = dev_measurements,
	.profile = AEGIS_DEVICE_PROFILE,
	.version = AEGIS_DEVICE_VERSION,
	.status = dev_status,
};

static K_SEM_DEFINE(got_ip, 0, 1);
static struct net_mgmt_event_callback mgmt_cb;

static void on_ipv4(struct net_mgmt_event_callback *cb, uint64_t ev, struct net_if *iface)
{
	ARG_UNUSED(cb);
	ARG_UNUSED(iface);
	if (ev == NET_EVENT_IPV4_ADDR_ADD) {
		k_sem_give(&got_ip);
	}
}

static void serve(void)
{
	struct sockaddr_in a = {0};
	struct timeval tv = {.tv_sec = 10};
	int s = zsock_socket(AF_INET, SOCK_STREAM, IPPROTO_TCP), one = 1;

	zsock_setsockopt(s, SOL_SOCKET, SO_REUSEADDR, &one, sizeof(one));
	a.sin_family = AF_INET;
	a.sin_port = htons(PORT);
	if (zsock_bind(s, (struct sockaddr *)&a, sizeof(a)) != 0 || zsock_listen(s, 4) != 0) {
		printk("aegis: cannot listen on %d\n", PORT);
		return;
	}
	for (;;) {
		int c = zsock_accept(s, NULL, NULL);
		size_t got = 0;
		ssize_t r;
		int n;
		char *nl = NULL;

		if (c < 0) {
			continue;
		}
		zsock_setsockopt(c, SOL_SOCKET, SO_RCVTIMEO, &tv, sizeof(tv));
		while (got < AEGIS_LINE_MAX && (r = zsock_recv(c, line + got, AEGIS_LINE_MAX - got, 0)) > 0) {
			got += (size_t)r;
			nl = memchr(line, '\n', got);
			if (nl) {
				break;
			}
		}
		line[got] = 0;
		if (nl) {
			*nl = 0;
		}
		if (!nl && got >= AEGIS_LINE_MAX) {
			n = snprintf(reply, sizeof(reply), "ERR too-long");
		} else {
			n = aegis_prover_handle_line(&core, line, reply, sizeof(reply));
		}
		memcpy(reply + n, "\r\n", 2);
		for (size_t off = 0; off < (size_t)n + 2;) {
			r = zsock_send(c, reply + off, (size_t)n + 2 - off, 0);
			if (r <= 0) {
				break;
			}
			off += (size_t)r;
		}
		zsock_close(c);
	}
}

static void prover(void *a, void *b, void *c)
{
	uint8_t seed[32], root[32], fp[32], meas[32];
	struct net_if *iface = net_if_get_default();
	size_t img;
	int rc;

	printk("AEGIS-RW612-PROVER %s\n", AEGIS_DEVICE_VERSION);
	rc = aegis_els_init();
	aegis_els_dump_slots();
	if (rc == 0) {
		rc = aegis_els_derive("aegis-rw612-mldsa65-seed-v1", seed);
	}
	if (rc == 0) {
		rc = aegis_els_derive("aegis-rw612-provision-root-v1", root);
	}
	if (rc != 0) {
		printk("aegis: ELS key derivation failed (%d); no prover\n", rc);
		return;
	}
	{
		const struct aegis_config cfg = {
			.platform = &platform,
			.verifier_pk = gateway_pk,
			.identity_seed = seed,
			.exchange_root = root,
			.work = work,
			.work_len = sizeof(work),
		};

		rc = AEGIS_PROVER_INIT(&core, &cfg);
	}
	aegis_wipe(seed, sizeof(seed));
	aegis_wipe(root, sizeof(root));
	if (rc != AEGIS_OK) {
		printk("aegis: ML-DSA key generation failed\n");
		return;
	}
	aegis_sha256(aegis_prover_public_key(&core), AEGIS_PK_LEN, fp);
	dev_measure(meas, &img);
	printk("aegis: key sha256 %02x%02x%02x%02x%02x%02x%02x%02x..., image %u bytes, sha256 "
	       "%02x%02x%02x%02x%02x%02x%02x%02x...\n",
	       fp[0], fp[1], fp[2], fp[3], fp[4], fp[5], fp[6], fp[7], (unsigned)img, meas[0], meas[1], meas[2],
	       meas[3], meas[4], meas[5], meas[6], meas[7]);

	/* a stable, per-chip MAC address (locally administered), set while the interface is down */
	{
		struct ethernet_req_params p = {0};
		uint8_t *mac = p.mac_address.addr;

		mac[0] = 0x02; mac[1] = 0xae;
		memcpy(mac + 2, aegis_prover_public_key(&core), 4);
		net_if_down(iface);
		rc = net_mgmt(NET_REQUEST_ETHERNET_SET_MAC_ADDRESS, iface, &p, sizeof(p));
		net_if_up(iface);
		printk("aegis: mac %02x:%02x:%02x:%02x:%02x:%02x%s\n", mac[0], mac[1], mac[2], mac[3], mac[4], mac[5],
		       rc ? " (not set: the board's default stays)" : "");
	}
	net_mgmt_init_event_callback(&mgmt_cb, on_ipv4, NET_EVENT_IPV4_ADDR_ADD);
	net_mgmt_add_event_callback(&mgmt_cb);
	net_dhcpv4_start(iface);
	k_sem_take(&got_ip, K_FOREVER);
	{
		char buf[NET_IPV4_ADDR_LEN];
		struct net_if_ipv4 *ip = iface->config.ip.ipv4;

		printk("aegis: address %s, listening on %d\n",
		       net_addr_ntop(AF_INET, &ip->unicast[0].ipv4.address.in_addr, buf, sizeof(buf)), PORT);
	}
	serve();
}

/* ML-DSA-65 signing and key generation need tens of KB of stack: the prover runs in its own thread */
K_THREAD_DEFINE(aegis_prover, 65536, prover, NULL, NULL, NULL, 7, 0, 0);

int main(void)
{
	return 0;
}
```

## src/aegis_els.c
```c
/* SPDX-License-Identifier: Apache-2.0
 *
 * Device-unique secrets from the RW612's ELS (EdgeLock Secure Subsystem), for the Aegis prover.
 *
 *   slot 0 holds NXP_DIE_MK_SK, the die master key: loaded by the boot ROM from the PUF, never readable by software.
 *   K   = CKDF-SP800-108(slot 0, 12-byte derivation data "AEGIS-RW612\1") -> a free ELS slot, HMAC use only
 *   out = HMAC-SHA256(K, label)                                   computed inside ELS, 32 bytes returned
 *   K is deleted from its slot afterwards.
 *
 * The same chip gives the same output on every boot; another chip gives another one. Software sees `out`, never the
 * die key nor K. A firmware running on this chip can call ELS the same way, so the secret is bound to the chip, not
 * to the firmware (see endpoints/rw612/README.md).
 */
#include <string.h>
#if defined(__ZEPHYR__)
#include <zephyr/kernel.h>
#include <zephyr/sys/printk.h>
#else
#define printk(...) ((void)0) /* TF-M secure partition: no console output from here */
#endif

#include <mcuxClEls.h>
#include <mcuxClCore_FunctionIdentifiers.h>
#include <mcuxCsslFlowProtection.h>

#include "aegis_els.h"

#define DIE_MASTER_KEY_SLOT 0u

static const uint8_t ddata[MCUXCLELS_CKDF_DERIVATIONDATA_SIZE] __aligned(4) = {'A', 'E', 'G', 'I', 'S', '-',
									      'R', 'W', '6', '1', '2', 1};

/* Run a flow-protected ELS call, check its protection token and its result. */
#define ELS_CALL(ok, fname, call, expect)                                                                         \
	do {                                                                                                      \
		MCUX_CSSL_FP_FUNCTION_CALL_BEGIN(r_, t_, call);                                                   \
		(ok) = (MCUX_CSSL_FP_FUNCTION_CALLED(fname) == t_) && (r_ == (expect));                          \
		MCUX_CSSL_FP_FUNCTION_CALL_END();                                                                 \
	} while (0)

static int els_wait(void)
{
	int ok;

	ELS_CALL(ok, mcuxClEls_WaitForOperation, mcuxClEls_WaitForOperation(MCUXCLELS_ERROR_FLAGS_CLEAR),
		 MCUXCLELS_STATUS_OK);
	return ok ? 0 : -1;
}

static int key_props(unsigned slot, uint32_t *word)
{
	mcuxClEls_KeyProp_t p;
	int ok;

	p.word.value = 0;
	ELS_CALL(ok, mcuxClEls_GetKeyProperties, mcuxClEls_GetKeyProperties((mcuxClEls_KeyIndex_t)slot, &p),
		 MCUXCLELS_STATUS_OK);
	*word = p.word.value;
	return ok ? 0 : -1;
}

/* ELS is already on when the application starts: the boot ROM enables it to load the die key (slots 0 to 7 hold the
 * ROM's keys). mcuxClEls_Enable_Async() is not called: it writes the whole ELS_CTRL register (ELS_CTRL = ELS_EN) and
 * would clear whatever else the ROM set there. Only wait until ELS is idle. */
int aegis_els_init(void)
{
	return els_wait();
}

void aegis_els_dump_slots(void)
{
	for (unsigned s = 0; s < MCUXCLELS_KEY_SLOTS; s++) {
		uint32_t w;

		if (key_props(s, &w) == 0 && (w & MCUXCLELS_KEYPROPERTY_VALUE_ACTIVE)) {
			printk("els slot %2u: props 0x%08x\n", s, w);
		}
	}
}

/* A 256-bit key takes two consecutive slots (a base slot and the next one; the die key is slots 0 and 1). Find an
 * even base slot whose pair is empty, from the top (the ROM's keys sit at the bottom). Asking ELS for a 256-bit key
 * in the last slot is a fault, and on this chip an ELS fault resets the chip. */
static int free_slot(void)
{
	for (int s = MCUXCLELS_KEY_SLOTS - 2; s >= 2; s -= 2) {
		uint32_t a, b;

		if (key_props((unsigned)s, &a) == 0 && key_props((unsigned)s + 1u, &b) == 0 &&
		    !(a & MCUXCLELS_KEYPROPERTY_VALUE_ACTIVE) && !(b & MCUXCLELS_KEYPROPERTY_VALUE_ACTIVE)) {
			return s;
		}
	}
	return -1;
}

int aegis_els_derive(const char *label, uint8_t out[32])
{
	static uint8_t in[64] __aligned(4);
	static uint8_t mac[MCUXCLELS_HMAC_OUTPUT_SIZE] __aligned(4);
	mcuxClEls_KeyProp_t prop;
	mcuxClEls_HmacOption_t opt;
	uint32_t master;
	size_t n = strlen(label);
	int slot, ok, rc = -1;

	/* Slot 0 must hold the ROM's die master key: active, a base slot, device-unique, usable for CKDF (on this
	 * chip 0x60010161). After an ELS reset another key could sit in slot 0; deriving from it would give a
	 * different, non-device-bound seed, so refuse. */
	const uint32_t want = MCUXCLELS_KEYPROPERTY_VALUE_ACTIVE | MCUXCLELS_KEYPROPERTY_VALUE_BASE_SLOT |
			      MCUXCLELS_KEYPROPERTY_VALUE_DUK | MCUXCLELS_KEYPROPERTY_VALUE_CKDF;

	if (n > sizeof(in) || key_props(DIE_MASTER_KEY_SLOT, &master) != 0 || (master & want) != want) {
		return -2; /* no die master key for derivation */
	}
	slot = free_slot();
	if (slot < 0) {
		return -3;
	}
	prop.word.value = 0;
	prop.bits.ksize = MCUXCLELS_KEYPROPERTY_KEY_SIZE_256;
	prop.bits.kactv = MCUXCLELS_KEYPROPERTY_ACTIVE_TRUE;
	prop.bits.uhmac = MCUXCLELS_KEYPROPERTY_HMAC_TRUE;
	prop.bits.upprot_priv = MCUXCLELS_KEYPROPERTY_PRIVILEGED_TRUE;
	prop.bits.upprot_sec = MCUXCLELS_KEYPROPERTY_SECURE_TRUE;
	ELS_CALL(ok, mcuxClEls_Ckdf_Sp800108_Async,
		 mcuxClEls_Ckdf_Sp800108_Async(DIE_MASTER_KEY_SLOT, (mcuxClEls_KeyIndex_t)slot, prop, ddata),
		 MCUXCLELS_STATUS_OK_WAIT);
	if (!ok || els_wait() != 0) {
		return -4;
	}
	memcpy(in, label, n);
	opt.word.value = 0;
	opt.bits.extkey = MCUXCLELS_HMAC_EXTERNAL_KEY_DISABLE;
	ELS_CALL(ok, mcuxClEls_Hmac_Async, mcuxClEls_Hmac_Async(opt, (mcuxClEls_KeyIndex_t)slot, NULL, in, n, mac),
		 MCUXCLELS_STATUS_OK_WAIT);
	if (ok && els_wait() == 0) {
		memcpy(out, mac, 32);
		rc = 0;
	} else {
		rc = -5;
	}
	memset(mac, 0, sizeof(mac));
	ELS_CALL(ok, mcuxClEls_KeyDelete_Async, mcuxClEls_KeyDelete_Async((mcuxClEls_KeyIndex_t)slot),
		 MCUXCLELS_STATUS_OK_WAIT);
	if (!ok || els_wait() != 0) {
		rc = rc ? rc : -6;
	}
	return rc;
}
```

## src/aegis_els.h
```c
/* SPDX-License-Identifier: Apache-2.0 */
#ifndef AEGIS_ELS_H
#define AEGIS_ELS_H
#include <stdint.h>

int aegis_els_init(void);
void aegis_els_dump_slots(void);
/* 32 bytes = HMAC-SHA256(CKDF(die master key), label), computed inside ELS. 0 on success. */
int aegis_els_derive(const char *label, uint8_t out[32]);
#endif
```

## src/aegis_proto.h
```c
/* SPDX-License-Identifier: Apache-2.0 */
#ifndef AEGIS_PROTO_H
#define AEGIS_PROTO_H
#include <stddef.h>
#include <stdint.h>

#ifndef AEGIS_DEVICE_PROFILE
#define AEGIS_DEVICE_PROFILE "aegis-rw612-els-v1"
#endif
#ifndef AEGIS_DEVICE_FW
#define AEGIS_DEVICE_FW      "rw612"
#endif
#ifndef AEGIS_DEVICE_VERSION
#define AEGIS_DEVICE_VERSION "0.1.0"
#endif
/* the longest request: PQKEMFIN, a 1088-byte ciphertext and a credential of up to 6144 bytes, in hex */
#define AEGIS_LINE_MAX 14600u
#define AEGIS_REPLY_MAX 9600u

/* One reported software component (PSA claim names): its type label, SHA-256 value and a description. */
struct aegis_measurement {
	const char *label;
	uint8_t value[32];
	char desc[64];
};
/* The defaults fit every endpoint but the ZynqMP TA, whose build raises both (endpoints/zynqmp/optee/ta/sub.mk).
 * The claims take 121 bytes plus, per component, 81 + its label + its description (2 more from 24 characters). */
#ifndef AEGIS_MAX_MEASUREMENTS
#define AEGIS_MAX_MEASUREMENTS 4
#endif
#ifndef AEGIS_CLAIMS_MAX
#define AEGIS_CLAIMS_MAX 1024u
#endif

/* A session ends on the endpoint's own clock (docs/endpoint-expiry.md). The credential's lifetime is its signed
 * "expires" minus "issued", at most AEGIS_CRED_LIFETIME_MAX seconds; the session lives that long plus a margin of one
 * sixteenth. The margin covers a clock up to 6 % fast (the least exact one is the STM32's RC oscillator, good to a
 * few per cent), so an endpoint does not end a session before the gateway's own expiry. */
#define AEGIS_CRED_LIFETIME_MAX 86400u
#define AEGIS_SESSION_LIMIT(lifetime) ((uint64_t)(lifetime) + (lifetime) / 16u)

struct aegis_proto_platform {
	int (*random)(uint8_t *out, size_t n);           /* hardware randomness; 0 on success */
	void (*measure)(uint8_t out[32], size_t *len);   /* SHA-256 of the running image, and its length (APP) */
	uint32_t (*uptime_s)(void);
	/* Required. Seconds from a counter that only advances and that nothing outside this image (the non-secure
	 * side, the normal world) can set, slow or stop; any origin. Returns 0, or nonzero when the counter cannot be
	 * trusted now: the session then ends and no new one starts. */
	int (*monotonic_s)(uint64_t *now);
	/* Optional, used when set (the TF-M partition sets them; the Zephyr prover leaves them 0): */
	const char *profile;                                               /* claims profile */
	size_t (*measure_all)(struct aegis_measurement *m, size_t max);    /* several components instead of APP */
	int (*status)(char *buf, size_t cap);                              /* heartbeat status text */
};

/* seed: the ML-DSA-65 key seed, root: the provisioning root (both device-unique), gateway_pk: the pinned key */
int aegis_proto_init(const struct aegis_proto_platform *pl, const uint8_t seed[32], const uint8_t root[32],
		     const uint8_t gateway_pk[1952]);
const uint8_t *aegis_proto_pk(void);
/* One request line (changed in place) -> reply without line end in out; returns its length. */
int aegis_proto_handle(char *line, char *out, size_t cap);
#endif
```

## src/sha256.c
```c
/* SPDX-License-Identifier: Apache-2.0
 * SHA-256 (FIPS 180-4), small and simple: the image measurement and the key fingerprint. */
#include <string.h>
#include "sha256.h"

static const uint32_t K[64] = {
	0x428a2f98, 0x71374491, 0xb5c0fbcf, 0xe9b5dba5, 0x3956c25b, 0x59f111f1, 0x923f82a4, 0xab1c5ed5,
	0xd807aa98, 0x12835b01, 0x243185be, 0x550c7dc3, 0x72be5d74, 0x80deb1fe, 0x9bdc06a7, 0xc19bf174,
	0xe49b69c1, 0xefbe4786, 0x0fc19dc6, 0x240ca1cc, 0x2de92c6f, 0x4a7484aa, 0x5cb0a9dc, 0x76f988da,
	0x983e5152, 0xa831c66d, 0xb00327c8, 0xbf597fc7, 0xc6e00bf3, 0xd5a79147, 0x06ca6351, 0x14292967,
	0x27b70a85, 0x2e1b2138, 0x4d2c6dfc, 0x53380d13, 0x650a7354, 0x766a0abb, 0x81c2c92e, 0x92722c85,
	0xa2bfe8a1, 0xa81a664b, 0xc24b8b70, 0xc76c51a3, 0xd192e819, 0xd6990624, 0xf40e3585, 0x106aa070,
	0x19a4c116, 0x1e376c08, 0x2748774c, 0x34b0bcb5, 0x391c0cb3, 0x4ed8aa4a, 0x5b9cca4f, 0x682e6ff3,
	0x748f82ee, 0x78a5636f, 0x84c87814, 0x8cc70208, 0x90befffa, 0xa4506ceb, 0xbef9a3f7, 0xc67178f2};

static uint32_t ror(uint32_t x, unsigned n)
{
	return (x >> n) | (x << (32 - n));
}

static void block(uint32_t h[8], const uint8_t *p)
{
	uint32_t w[64], a, b, c, d, e, f, g, k, t1, t2;

	for (int i = 0; i < 16; i++) {
		w[i] = (uint32_t)p[4 * i] << 24 | (uint32_t)p[4 * i + 1] << 16 | (uint32_t)p[4 * i + 2] << 8 | p[4 * i + 3];
	}
	for (int i = 16; i < 64; i++) {
		uint32_t s0 = ror(w[i - 15], 7) ^ ror(w[i - 15], 18) ^ (w[i - 15] >> 3);
		uint32_t s1 = ror(w[i - 2], 17) ^ ror(w[i - 2], 19) ^ (w[i - 2] >> 10);

		w[i] = w[i - 16] + s0 + w[i - 7] + s1;
	}
	a = h[0]; b = h[1]; c = h[2]; d = h[3]; e = h[4]; f = h[5]; g = h[6]; k = h[7];
	for (int i = 0; i < 64; i++) {
		t1 = k + (ror(e, 6) ^ ror(e, 11) ^ ror(e, 25)) + ((e & f) ^ (~e & g)) + K[i] + w[i];
		t2 = (ror(a, 2) ^ ror(a, 13) ^ ror(a, 22)) + ((a & b) ^ (a & c) ^ (b & c));
		k = g; g = f; f = e; e = d + t1; d = c; c = b; b = a; a = t1 + t2;
	}
	h[0] += a; h[1] += b; h[2] += c; h[3] += d; h[4] += e; h[5] += f; h[6] += g; h[7] += k;
}

void sha256(const uint8_t *p, size_t n, uint8_t out[32])
{
	uint32_t h[8] = {0x6a09e667, 0xbb67ae85, 0x3c6ef372, 0xa54ff53a, 0x510e527f, 0x9b05688c, 0x1f83d9ab, 0x5be0cd19};
	uint8_t last[128];
	size_t full = n & ~(size_t)63, rem = n - full, tail;
	uint64_t bits = (uint64_t)n * 8;

	for (size_t i = 0; i < full; i += 64) {
		block(h, p + i);
	}
	memset(last, 0, sizeof(last));
	memcpy(last, p + full, rem);
	last[rem] = 0x80;
	tail = rem < 56 ? 64 : 128;
	for (int i = 0; i < 8; i++) {
		last[tail - 1 - i] = (uint8_t)(bits >> (8 * i));
	}
	block(h, last);
	if (tail == 128) {
		block(h, last + 64);
	}
	for (int i = 0; i < 8; i++) {
		out[4 * i] = (uint8_t)(h[i] >> 24); out[4 * i + 1] = (uint8_t)(h[i] >> 16);
		out[4 * i + 2] = (uint8_t)(h[i] >> 8); out[4 * i + 3] = (uint8_t)h[i];
	}
}
```

## src/sha256.h
```c
/* SPDX-License-Identifier: Apache-2.0 */
#ifndef AEGIS_SHA256_H
#define AEGIS_SHA256_H
#include <stddef.h>
#include <stdint.h>

void sha256(const uint8_t *p, size_t n, uint8_t out[32]);
#endif
```
